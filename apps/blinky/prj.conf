## CMakeLists.txt
```
cmake_minimum_required(VERSION 3.20.0)

# NCS 3.4.1 needs Seeed's external board definitions for this XIAO.
# Board roots must be added before find_package(Zephyr).
list(APPEND BOARD_ROOT
    "${CMAKE_CURRENT_SOURCE_DIR}/../../third_party/platform-seeedboards/zephyr/nrf"
)

# NCS 3.4.1's nrf_security caches these strings without Kconfig quotes.
# On reconfigure, Zephyr mistakes them for command-line Kconfig overrides.
# Discard those malformed entries; Kconfig reloads the configured values.
# Preserve correctly quoted overrides supplied explicitly by the user.
foreach(symbol IN ITEMS
    CONFIG_MBEDTLS_CONFIG_FILE
    CONFIG_TF_PSA_CRYPTO_CONFIG_FILE
    CONFIG_TF_PSA_CRYPTO_USER_CONFIG_FILE
)
    if(DEFINED CACHE{${symbol}} AND NOT "$CACHE{${symbol}}" MATCHES "^\".*\"$")
        unset(${symbol} CACHE)
    endif()
endforeach()

find_package(Zephyr REQUIRED HINTS $ENV{ZEPHYR_BASE})
project(xiao_blinky)

target_sources(app PRIVATE src/main.c)
```

## prj.conf
```kconfig
# Application software features. The board supplies pin and power defaults.
CONFIG_GPIO=y

# V1.0 UART console is carried to the PC by the SAMD11 USB bridge.
CONFIG_PRINTK=y
CONFIG_SERIAL=y
CONFIG_CONSOLE=y
CONFIG_UART_CONSOLE=y
```

## debug.conf
```kconfig
# Use -Og so source-level stepping and local variables are easier to follow.
CONFIG_DEBUG_OPTIMIZATIONS=y

# Include Zephyr thread metadata for debugger inspection.
CONFIG_DEBUG_THREAD_INFO=y
```

## app.overlay
```dts
/* Use the RGB LED pins as GPIO, without a PWM driver claiming them. */
&pwm20 {
	status = "disabled";
};

/* V1.0's Nordic USB pins are unconnected. USB-C uses the SAMD11 bridge. */
&usbhs {
	status = "disabled";
};

&usbhs_wrapper {
	status = "disabled";
};

&vregusb {
	status = "disabled";
};
```

## src/main.c
```c
#include <stdbool.h>

#include <zephyr/drivers/gpio.h>
#include <zephyr/kernel.h>
#include <zephyr/sys/printk.h>

#define BLINK_INTERVAL_MS 2500

/* Seeed's board definition maps led0 to the blue LED on P1.23. */
static const struct gpio_dt_spec led = GPIO_DT_SPEC_GET(DT_ALIAS(led0), gpios);

int main(void)
{
	int err;
	bool led_on = false;

	if (!gpio_is_ready_dt(&led)) {
		printk("LED GPIO device is not ready\n");
		return -1;
	}

	err = gpio_pin_configure_dt(&led, GPIO_OUTPUT_INACTIVE);
	if (err < 0) {
		printk("LED configuration failed: %d\n", err);
		return err;
	}

	printk("XIAO nRF54LM20A V1.0 blinky started\n");

	while (true) {
		led_on = !led_on;

		/* The devicetree API applies the LED's active-low polarity. */
		err = gpio_pin_set_dt(&led, led_on);
		if (err < 0) {
			printk("LED update failed: %d\n", err);
			return err;
		}

		printk("LED %s\n", led_on ? "on" : "off");
		k_msleep(BLINK_INTERVAL_MS);
	}

	return 0;
}
```
